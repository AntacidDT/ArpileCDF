#include <string.h>
#include "arpile_ui_draw.h"
#include "arpile_icons.h"
#include "arpile_icon_img.h"

/* 5x7 font, 7 rows of 5 bits each, MSB first. Covers ASCII 0x20..0x7E. */
static const uint8_t font5x7[95][7] = {
    {0x00,0x00,0x00,0x00,0x00,0x00,0x00},
    {0x04,0x04,0x04,0x04,0x00,0x00,0x04},
    {0x0A,0x0A,0x00,0x00,0x00,0x00,0x00},
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    {0x00,0x08,0x15,0x02,0x00,0x00,0x00},
};

#define CHAR_W 10
#define CHAR_H 14

static const ui_rect_t *s_compositor_clip = NULL;

/* Full-screen software compositing framebuffer (RGB565). */
static uint16_t s_fb[UI_W * UI_H];

void ui_set_compositor_clip(const ui_rect_t *clip)
{
    s_compositor_clip = clip;
}

const ui_rect_t *ui_get_compositor_clip(void)
{
    return s_compositor_clip;
}

void ui_fb_clear(uint16_t color)
{
    for (int i = 0; i < UI_W * UI_H; i++) {
        s_fb[i] = color;
    }
}

void ui_fb_fill(uint16_t x, uint16_t y, uint16_t w, uint16_t h, uint16_t color)
{
    for (uint16_t yy = y; yy < y + h; yy++) {
        for (uint16_t xx = x; xx < x + w; xx++) {
            s_fb[yy * UI_W + xx] = color;
        }
    }
}

void ui_fb_blit(const uint16_t *img, uint16_t x, uint16_t y,
                uint16_t w, uint16_t h,
                uint16_t src_x, uint16_t src_y, uint16_t src_w, uint16_t src_h,
                uint16_t img_w)
{
    for (uint16_t r = 0; r < h; r++) {
        for (uint16_t c = 0; c < w; c++) {
            uint16_t sx = (uint32_t)src_x + ((uint32_t)c * src_w) / w;
            uint16_t sy = (uint32_t)src_y + ((uint32_t)r * src_h) / h;
            s_fb[(y + r) * UI_W + (x + c)] = img[sy * img_w + sx];
        }
    }
}

void ui_fb_flush(ili9488_t *lcd, const ui_rect_t *r)
{
    ui_rect_t screen = { 0, 0, UI_W, UI_H };
    ui_rect_t c;
    if (!ui_rect_clip(r, &screen, &c)) {
        return;
    }
    ili9488_draw_pixels(lcd, s_fb,
                        c.x, c.y, c.w, c.h,
                        c.x, c.y, c.w, c.h, UI_W);
}

/* Blit a packed RGB666 source (3 bytes/pixel, row-major) into the RGB565
 * compositor framebuffer, converting on the fly.  Clipped to the screen. */
void ui_fb_write_rgb666(const uint8_t *src, uint16_t x, uint16_t y,
                        uint16_t w, uint16_t h)
{
    for (uint16_t r = 0; r < h; r++) {
        uint16_t dy = y + r;
        if (dy >= UI_H) break;
        for (uint16_t c = 0; c < w; c++) {
            uint16_t dx = x + c;
            if (dx >= UI_W) break;
            const uint8_t *px = &src[(r * w + c) * 3];
            uint16_t rgb565 = (uint16_t)(((px[0] >> 3) << 11) |
                                          ((px[1] >> 2) << 5)  |
                                           (px[2] >> 3));
            s_fb[dy * UI_W + dx] = rgb565;
        }
    }
}

void ui_draw_fill_rect(ili9488_t *lcd, const ui_rect_t *r, uint16_t color)
{
    (void)lcd;
    ui_rect_t c;
    ui_rect_t screen = { 0, 0, UI_W, UI_H };
    if (s_compositor_clip) {
        if (!ui_rect_clip(r, s_compositor_clip, &c)) {
            return;
        }
        if (ui_rect_clip(&c, &screen, &c)) {
            ui_fb_fill(c.x, c.y, c.w, c.h, color);
        }
    } else if (ui_rect_clip(r, &screen, &c)) {
        ui_fb_fill(c.x, c.y, c.w, c.h, color);
    }
}

void ui_draw_hline(ili9488_t *lcd, uint16_t x, uint16_t y, uint16_t w, uint16_t color)
{
    const ui_rect_t r = { x, y, w, 1 };
    ui_draw_fill_rect(lcd, &r, color);
}

void ui_draw_vline(ili9488_t *lcd, uint16_t x, uint16_t y, uint16_t h, uint16_t color)
{
    const ui_rect_t r = { x, y, 1, h };
    ui_draw_fill_rect(lcd, &r, color);
}

void ui_draw_outline(ili9488_t *lcd, const ui_rect_t *r, uint16_t color)
{
    ui_draw_hline(lcd, r->x, r->y, r->w, color);
    ui_draw_hline(lcd, r->x, (uint16_t)(r->y + r->h - 1), r->w, color);
    ui_draw_vline(lcd, r->x, r->y, r->h, color);
    ui_draw_vline(lcd, (uint16_t)(r->x + r->w - 1), r->y, r->h, color);
}

uint16_t ui_font_height(void)
{
    return CHAR_H;
}

uint16_t ui_text_width(const char *s)
{
    return (uint16_t)(strlen(s) * CHAR_W);
}

uint16_t ui_char_width(char c)
{
    (void)c;
    return CHAR_W;
}

static void draw_char_scaled(ili9488_t *lcd, uint16_t x, uint16_t y, char c,
                             uint16_t fg, uint16_t bg)
{
    if (c < 0x20 || c > 0x7E) {
        c = ' ';
    }
    const uint8_t *g = font5x7[c - 0x20];
    for (int row = 0; row < 7; row++) {
        for (int col = 0; col < 5; col++) {
            uint16_t color = (g[row] & (0x10 >> col)) ? fg : bg;
            ui_draw_fill_rect(lcd, &(ui_rect_t){ (uint16_t)(x + col * 2),
                              (uint16_t)(y + row * 2), 2, 2 }, color);
        }
    }
}

uint16_t ui_draw_text(ili9488_t *lcd, uint16_t x, uint16_t y,
                      const char *s, uint16_t fg, uint16_t bg)
{
    uint16_t cx = x;
    while (*s) {
        if (*s == '\n' || *s == '\t') {
            draw_char_scaled(lcd, cx, y, ' ', fg, bg);
        } else {
            draw_char_scaled(lcd, cx, y, *s, fg, bg);
        }
        cx = (uint16_t)(cx + CHAR_W);
        s++;
    }
    return cx;
}

bool ui_draw_icon(ili9488_t *lcd, const char *name,
                  uint16_t x, uint16_t y, uint16_t fg, uint16_t bg)
{
    for (size_t i = 0; i < ARPILE_ICON_COUNT; i++) {
        if (strcmp(arpile_icons[i].name, name) == 0) {
            const uint8_t *rows = arpile_icons[i].rows;
            for (int row = 0; row < ARPILE_ICON_SIZE; row++) {
                uint16_t bits = ((uint16_t)rows[row * 2] << 8) | rows[row * 2 + 1];
                for (int col = 0; col < ARPILE_ICON_SIZE; col++) {
                    uint16_t color = (bits & (0x8000 >> col)) ? fg : bg;
                    ui_draw_fill_rect(lcd, &(ui_rect_t){ (uint16_t)(x + col),
                                      (uint16_t)(y + row), 1, 1 }, color);
                }
            }
            return true;
        }
    }
    return false;
}

bool ui_draw_icon_scaled(ili9488_t *lcd, const char *name,
                         uint16_t x, uint16_t y, uint8_t scale,
                         uint16_t fg, uint16_t bg)
{
    if (scale < 1) scale = 1;
    for (size_t i = 0; i < ARPILE_ICON_COUNT; i++) {
        if (strcmp(arpile_icons[i].name, name) == 0) {
            const uint8_t *rows = arpile_icons[i].rows;
            for (int row = 0; row < ARPILE_ICON_SIZE; row++) {
                uint16_t bits = ((uint16_t)rows[row * 2] << 8) | rows[row * 2 + 1];
                for (int col = 0; col < ARPILE_ICON_SIZE; col++) {
                    uint16_t color = (bits & (0x8000 >> col)) ? fg : bg;
                    ui_draw_fill_rect(lcd, &(ui_rect_t){
                                      (uint16_t)(x + col * scale),
                                      (uint16_t)(y + row * scale),
                                      scale, scale }, color);
                }
            }
            return true;
        }
    }
    return false;
}

bool ui_draw_icon_img(ili9488_t *lcd, const char *name,
                      uint16_t x, uint16_t y, uint16_t size)
{
    for (size_t i = 0; i < ARPILE_ICON_IMG_COUNT; i++) {
        if (strcmp(arpile_icon_imgs[i].name, name) == 0) {
            const uint8_t *src = arpile_icon_imgs[i].pix;
            for (uint16_t dy = 0; dy < size; dy++) {
                for (uint16_t dx = 0; dx < size; dx++) {
                    uint16_t sx = (uint32_t)dx * ARPILE_ICON_IMG_SIZE / size;
                    uint16_t sy = (uint32_t)dy * ARPILE_ICON_IMG_SIZE / size;
                    uint32_t idx = (uint32_t)(sy * ARPILE_ICON_IMG_SIZE + sx) * 2;
                    uint16_t rgb = ((uint16_t)src[idx] << 8) | src[idx + 1];
                    ui_draw_fill_rect(lcd,
                                      &(ui_rect_t){ (uint16_t)(x + dx),
                                                    (uint16_t)(y + dy), 1, 1 },
                                      rgb);
                }
            }
            return true;
        }
    }
    return false;
}
